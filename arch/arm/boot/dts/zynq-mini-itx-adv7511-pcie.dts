/dts-v1/;
/include/ "zynq-mini-itx.dtsi"

/ {

	axi-pcie@50000000 {
		#address-cells = <0x3>;
		#size-cells = <0x2>;
		#interrupt-cells = <0x1>;
		compatible = "xlnx,axi-pcie-host-1.00.a";
		reg = <0x50000000 0x10000000>;
		device_type = "pci";
		interrupt-parent = <&intc>;
		interrupts = <0 0x3b 4>;
		interrupt-map-mask = <0x0 0x0 0x0 0x7>;
		interrupt-map = <0x0 0x0 0x0 0x1 0x5 0x1 0x0 0x0 0x0 0x2 0x5 0x2 0x0 0x0 0x0 0x3 0x5 0x3 0x0 0x0 0x0 0x4 0x5 0x4>;
		ranges = <0x2000000 0x0 0x60000000 0x60000000 0x0 0x10000000>;

		interrupt-controller {
			interrupt-controller;
			#address-cells = <0x0>;
			#interrupt-cells = <0x1>;
		};
	};
};

&clkc {
		ps-clk-frequency = <0x1fca055>;
		fclk-enable = <0xf>;
};
