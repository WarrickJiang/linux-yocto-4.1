## drivers/staging/fsl_rman/Kconfig
```kconfig
config FSL_RMAN_UIO
	tristate "Freescale RapidIO Message Manager support"
	depends on UIO
	default y
```

## drivers/staging/rtl8723be/Kconfig
```kconfig
config R8723BE
	tristate "Realtek 8723BE PCI WiFi"
	depends on PCI
	---help---
	This option adds the Realtek RTL8723BE PCIe device.
	If built as a module, it will be called 8723be.
```

## drivers/video/fbdev/owl/Kconfig
```kconfig
menuconfig VIDEO_OWL
	bool "OWL video support"
	depends on ARCH_OWL
        help
	  Actions OWL Soc video support.

if VIDEO_OWL
source "drivers/video/fbdev/owl/vce/Kconfig"
source "drivers/video/fbdev/owl/vde/Kconfig"
source "drivers/video/fbdev/owl/backlight/Kconfig"
source "drivers/video/fbdev/owl/dss/Kconfig"
source "drivers/video/fbdev/owl/displays/Kconfig"
source "drivers/video/fbdev/owl/fb/Kconfig"

source "drivers/video/fbdev/owl/switch/Kconfig"
endif
```

## drivers/video/fbdev/owl/displays/Kconfig
```kconfig
source "drivers/video/fbdev/owl/displays/lcdc/Kconfig"
source "drivers/video/fbdev/owl/displays/dsi/Kconfig"
source "drivers/video/fbdev/owl/displays/hdmi/Kconfig"
source "drivers/video/fbdev/owl/displays/cvbs/Kconfig"
#source "drivers/video/fbdev/owl/displays/edp/Kconfig"
```
